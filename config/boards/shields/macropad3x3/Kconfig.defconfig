## config/boards/shields/macropad3x3/Kconfig.defconfig
```kconfig
# Copyright (c) 2024
# SPDX-License-Identifier: MIT

if SHIELD_MACROPAD3X3

config ZMK_KEYBOARD_NAME
    default "Macropad 3x3"

config ZMK_DISPLAY
    select LV_USE_CONT
    select LV_FONT_MONTSERRAT_26

if ZMK_DISPLAY

config SSD1306
    default y

config I2C
    default y

config LV_Z_VDB_SIZE
    default 64

config LV_DPI_DEF
    default 148

config LV_Z_BITS_PER_PIXEL
    default 1

choice LV_COLOR_DEPTH
    default LV_COLOR_DEPTH_1
endchoice

endif # ZMK_DISPLAY

endif # SHIELD_MACROPAD3X3
```

## config/boards/shields/macropad3x3/Kconfig.shield
```kconfig
# Copyright (c) 2024
# SPDX-License-Identifier: MIT

config SHIELD_MACROPAD3X3
    def_bool $(shields_list_contains,macropad3x3)
```
